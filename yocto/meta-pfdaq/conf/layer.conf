## yocto/meta-pfdaq/conf/layer.conf
```bitbake
BBPATH .= ":${LAYERDIR}"
BBFILES += "${LAYERDIR}/recipes-*/*/*.bb ${LAYERDIR}/recipes-*/*/*.bbappend"
BBFILE_COLLECTIONS += "meta-pfdaq"
BBFILE_PATTERN_meta-pfdaq = "^${LAYERDIR}/"
BBFILE_PRIORITY_meta-pfdaq = "10"
LAYERDEPENDS_meta-pfdaq = "meta-mchp-polarfire-soc-bsp"
LAYERSERIES_COMPAT_meta-pfdaq = "scarthgap"
```
